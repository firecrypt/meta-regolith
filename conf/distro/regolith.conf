## conf/distro/regolith.conf
```bitbake
require conf/distro/poky.conf

DISTRO = "regolith"
DISTRO_NAME = "regolith"
SDK_VENDOR = "-regolith"
TARGET_VENDOR = "-regolith"

MAINTAINER = "firecrypt <firecrypt@protonmail.com>"

DISTRO_FEATURES ?= "${DISTRO_FEATURES_DEFAULT} ${DISTRO_FEATURES_LIBC}"

# use ipk/opkg for package management
PACKAGE_CLASSES ?= "package_ipk"
```
